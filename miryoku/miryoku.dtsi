// Copyright 2022 Manna Harbour
// https://github.com/manna-harbour/miryoku

#include <behaviors.dtsi>
#include <dt-bindings/zmk/keys.h>
#include <dt-bindings/zmk/bt.h>
#include <dt-bindings/zmk/rgb.h>
#include <dt-bindings/zmk/outputs.h>
#include <dt-bindings/zmk/ext_power.h>

#include "miryoku.h"

#include <dt-bindings/zmk/mouse.h>

/ {
  keymap {
    compatible = "zmk,keymap";
#define MIRYOKU_X(LAYER, STRING) \
    LAYER { \
      label = STRING; \
      bindings = < U_MACRO_VA_ARGS(MIRYOKU_LAYERMAPPING_##LAYER, MIRYOKU_LAYER_##LAYER) >; \
      sensor-bindings = <&inc_dec_kp RIGHT LEFT &inc_dec_kp PG_UP PG_DN>; \
    };
MIRYOKU_LAYER_LIST
#undef MIRYOKU_X
  };
};

/ {
    conditional_layers {
        compatible = "zmk,conditional-layers";
        tri_layer {
            if-layers = <7 4>;
            then-layer = <10>;
        };
    };
};

/ {
  behaviors {
    hm: homerow_mods {
      compatible = "zmk,behavior-hold-tap";
      label = "HOMEROW_MODS";
      #binding-cells = <2>;
      tapping_term_ms = <U_TAPPING_TERM>;
      flavor = "tap-preferred";
      bindings = <&kp>, <&kp>;
    };

    rpi: require_prior_idle {
    compatible = "zmk,behavior-hold-tap";
    #binding-cells = <2>;
    flavor = "tap-preferred";
    tapping-term-ms = <U_TAPPING_TERM>;
    quick-tap-ms = <200>;
    require-prior-idle-ms = <125>;
    bindings = <&kp>, <&kp>;
    };
  };
};

#include "miryoku_shift_functions.dtsi"

#include "miryoku_double_tap_guard.dtsi"

#if defined (MIRYOKU_KLUDGE_MOUSEKEYSPR)
  #include "miryoku_kludge_mousekeyspr.dtsi"
#else
  #include "miryoku_mousekeys.dtsi"
#endif

#if defined (MIRYOKU_KLUDGE_THUMBCOMBOS)
  #include "miryoku_kludge_thumbcombos.dtsi"
#endif

#if defined (MIRYOKU_KLUDGE_TOPROWCOMBOS)
  #include "miryoku_kludge_toprowcombos.dtsi"
#endif

#if defined (MIRYOKU_KLUDGE_BOTTOMROWCOMBOS)
  #include "miryoku_kludge_bottomrowcombos.dtsi"
#endif

#if defined (MIRYOKU_KLUDGE_TAPDELAY)
  #include "miryoku_kludge_tapdelay.dtsi"
#else
  #include "miryoku_behaviors.dtsi"
#endif
